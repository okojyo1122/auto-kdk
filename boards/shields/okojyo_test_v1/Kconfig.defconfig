## boards/shields/okojyo_test_v1/Kconfig.defconfig
```kconfig
if SHIELD_OKOJYO_TEST_V1_RIGHT

config ZMK_KEYBOARD_NAME
    default "okojyo_test_v1"

endif

if SHIELD_OKOJYO_TEST_V1_LEFT || SHIELD_OKOJYO_TEST_V1_RIGHT

config ZMK_SPLIT
    default y

endif
```

## boards/shields/okojyo_test_v1/Kconfig.shield
```kconfig
config SHIELD_OKOJYO_TEST_V1_LEFT
    def_bool $(shields_list_contains,okojyo_test_v1_left)
config SHIELD_OKOJYO_TEST_V1_RIGHT
    def_bool $(shields_list_contains,okojyo_test_v1_right)
```
